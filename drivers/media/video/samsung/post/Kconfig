## drivers/media/video/samsung/post/Kconfig
```kconfig
#
# Configuration for Post Porcessor
#

config VIDEO_POST
	bool "Samsung Post Processor Driver" 
	depends on VIDEO_SAMSUNG && (CPU_S3C6410 || CPU_S5PC100)
	default y
	---help---
	  This is a post processor driver for Samsung S3C6410 and S5P6440.
```
